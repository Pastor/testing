/*  ------------------------------------------------------
     Routine name:  my_diagram
     Description:   
     Project file:  2.prt

------------------------------------------------------  */

int i;
int j;
int c;
ret = 0;
memcpy(&state_vars->my_diagramv0_out_0_,&my_diagramv0_out_0_default,sizeof(my_diagramv0_out_0_default));
memcpy(&state_vars->my_diagramv1_out_0_,&my_diagramv1_out_0_default,sizeof(my_diagramv1_out_0_default));
memcpy(&state_vars->my_diagramv2_out_0_,&my_diagramv2_out_0_default,sizeof(my_diagramv2_out_0_default));
memcpy(&state_vars->my_diagramv3_out_0_,&my_diagramv3_out_0_default,sizeof(my_diagramv3_out_0_default));
memcpy(&state_vars->my_diagramv4_out_0_,&my_diagramv4_out_0_default,sizeof(my_diagramv4_out_0_default));
memcpy(&state_vars->my_diagramv4_out_1_,&my_diagramv4_out_1_default,sizeof(my_diagramv4_out_1_default));
v4_sinit__0:
;
